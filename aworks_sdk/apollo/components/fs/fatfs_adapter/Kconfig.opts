## aworks_sdk/apollo/components/fs/fatfs_adapter/Kconfig.opts
```kconfig
config AW_CFG_FATFS_FILES
    int "Files"
    default 1

config AW_CFG_FATFS_VOLUMES
    int "Volumes"
    default 1

config AW_CFG_FATFS_BLOCK_SIZE
    int "Block Size"
    default 512

config FF_FS_READONLY
    bool "FS Readonly"
    default n
    help
      This option switches read-only configuration. (0:Read/Write or 1:Read-only)
      Read-only configuration removes writing API functions, f_write(), f_sync(),
      f_unlink(), f_mkdir(), f_chmod(), f_rename(), f_truncate(), f_getfree()
      and optional writing functions as well.

config FF_LFN_UNICODE
    bool "LFN Unicode"
    default n
    help
     This option switches character encoding on the API, 0:ANSI/OEM or 1:UTF-16,
     when LFN is enabled. Also behavior of string I/O functions will be affected by
     this option. When LFN is not enabled, this option has no effect.

config FF_MULTI_PARTITION
    bool "Muiti Partition"
    default n
    help
      This option switches support for multiple volumes on the physical drive.
      By default (0), each logical drive number is bound to the same physical drive
      number and only an FAT volume found on the physical drive will be mounted.
      When this function is enabled (1), each logical drive number can be bound to
      arbitrary physical drive and partition listed in the VolToPart[]. Also f_fdisk()
      funciton will be available.

config FF_FS_EXFAT
    bool "FS exFAT"
    default y
    help
      This option switches support for exFAT filesystem. (0:Disable or 1:Enable)
      When enable exFAT, also LFN needs to be enabled.
      Note that enabling exFAT discards ANSI C (C89) compatibility.

config FF_CODE_PAGE
    int "Code Page"
    range 0 950
    default 936 
    help
      This option specifies the OEM code page to be used on the target system.
      Incorrect code page setting can cause a file open failure.
      437 - U.S.
      720 - Arabic
      737 - Greek
      771 - KBL
      775 - Baltic
      850 - Latin 1
      852 - Latin 2
      855 - Cyrillic
      857 - Turkish
      860 - Portuguese
      861 - Icelandic
      862 - Hebrew
      863 - Canadian French
      864 - Arabic
      865 - Nordic
      866 - Russian
      869 - Greek 2
      932 - Japanese (DBCS)
      936 - Simplified Chinese (DBCS)
      949 - Korean (DBCS)
      950 - Traditional Chinese (DBCS)
        0 - Include all code pages above and configured by f_setcp()


config FF_USE_LFN
    int "Use LFN"
    range 0 3
    default 3
    help
      The "Use LFN" switches the support for LFN (long file name).
       0: Disable LFN. FF_MAX_LFN has no effect.
       1: Enable LFN with static working buffer on the BSS. Always NOT thread-safe.
       2: Enable LFN with dynamic working buffer on the STACK.
       3: Enable LFN with dynamic working buffer on the HEAP.

      To enable the LFN, Unicode handling functions (option/unicode.c) must be added
      to the project. The working buffer occupies (FF_MAX_LFN + 1) * 2 bytes and
      additional 608 bytes at exFAT enabled. FF_MAX_LFN can be in range from 12 to 255.
      It should be set 255 to support full featured LFN operations.
      When use stack for the working buffer, take care on stack overflow. When use heap
      memory for the working buffer, memory management functions, ff_memalloc() and
      ff_memfree(), must be added to the project.

config FF_VOLUMES
    int "Volumes Number"
    range 1 10
    default 10
    help
      Number of volumes (logical drives) to be used. (1-10)

config FF_MAX_SS
    int "SS Max"
    range 512 4096
    default 4096
    help   
      Only  512,1024,2048,4096 can be writed.
      This set of options configures the range of sector size to be supported. (512,
      1024, 2048 or 4096) Always set both 512 for most systems, generic memory card and
      harddisk. But a larger value may be required for on-board flash memory and some
      type of optical media. When "SS Max" is larger than FF_MIN_SS, FatFs is configured
      for variable sector size mode and disk_ioctl() function needs to implement
      GET_SECTOR_SIZE command..

config FF_FS_LOCK
    int "FS Lock"
    default 10
    help
      The option "FS Lock" switches file lock function to control duplicated file open
      and illegal operation to open objects. This option must be 0 when FF_FS_READONLY
      is 1.
      0:  Disable file lock function. To avoid volume corruption, application program
          should avoid illegal open, remove and rename to the open objects.
      >0: Enable file lock function. The value defines how many files/sub-directories
          can be opened simultaneously under file lock control. Note that the file
          lock control is independent of re-entrancy.  
```

## aworks_sdk/apollo/components/fs/yaffs2_e57244d_adapter/Kconfig.opts
```kconfig
config AW_YAFFS_DEBUG_MSG
    bool "Debug Msg Enable"
    default n
    help
      Open yaffs debug info.

CONFIG_YAFFS_YAFFS2 = y

config CONFIG_YAFFS_DEFINES_TYPES
    bool "Defines Types"
    default y
    help
      Use yaffs define data type.

config CONFIG_YAFFS_PROVIDE_DEFS
    bool "Provide Defs"
    default y
    help
      Use yaffs provide file type and attribute defines.

config CONFIG_YAFFS_DIRECT
    bool "Direct Interface Enable"
    default y
    help
      Use yaffs direct interface.
```

## aworks_sdk/apollo/components/net/lwip_1.4.x_adapter/Kconfig
```kconfig
config AW_LWIP_14X_ADAPTER
    bool "LWIP 1.4.x"
    help
      lwIP(1.4.x) is a small independent implementation of the TCP/IP protocol suite.


if AW_LWIP_14X_ADAPTER
	
    menu "Memory Options"

        config LWIP_14X_MEM_ALIGNMENT
        int "Mem Alignment"
        range 2 4
        default 4
        help
          Help: should be set to the alignment of the CPU
                4 byte alignment ->  4
                2 byte alignment ->  2

        config LWIP_14X_MEM_SIZE
        int "Men Size(Unit: kb)"
        default 32
        help
          Help: the size of the heap memory. If the application will send a lot of data
                that needs to be copied, this should be set high.

        config LWIP_14X_MEMP_NUM_PBUF
        int "Pbufs Num"
        default 24
        help
          Help: The number of memp struct pbufs (used for PBUF_ROM and PBUF_REF).
                If the application sends a lot of data out of ROM (or other static memory),
                this should be set high.

        config LWIP_14X_MEMP_NUM_UDP_PCB
        int "UDP Connections Num"
        default 8
        help
          Help: the number of UDP protocol control blocks. One per active 
                UDP "connection".

        config LWIP_14X_MEMP_NUM_TCP_PCB
        int "TCP Connections Num"
        default 20
        help
          Help: the number of simulatenously active TCP connections.
                (requires the LWIP_14X_TCP option).


        config LWIP_14X_MEMP_NUM_TCP_PCB_LISTEN
        int "TCP Listening Num"
        default 10
        help
          Help: the number of listening TCP connections.
                (requires the LWIP_14X_TCP option).

        config LWIP_14X_MEMP_NUM_TCP_SEG
        int "TCP Segments Num"
        default 128
        help
          Help: the number of simultaneously queued TCP segments.
                (requires the LWIP_14X_TCP option)


        config LWIP_14X_MEMP_NUM_REASSDATA
        int "Reassdata Num"
        default 8
        help
          Help: the number of IP packets simultaneously queued for
                reassembly (whole packets, not fragments!)
        

        config LWIP_14X_MEMP_NUM_FRAG_PBUF
        int "Fragments Num"
        default 8
        help
          Help: the number of IP fragments simultaneously sent
                (fragments, not whole packets!).

        config LWIP_14X_MEMP_NUM_ARP_QUEUE
        int "ARP Queue Num"
        default 30
        help
          Help: the number of simulateously queued outgoing
                packets (pbufs) that are waiting for an ARP request (to resolve
                their destination address) to finish.
                (requires the ARP_QUEUEING option)            

        config LWIP_14X_MEMP_NUM_TCPIP_MSG_INPKT
        int "TCPIP MSG Num"
        default 8     
        help
          Help: the number of struct tcpip_msg, which are used for incoming packets.
                (only needed if you use tcpip.c)

        config LWIP_14X_MEMP_NUM_SNMP_NODE
        int "SNMP Node Num"
        default 50
        help
          Help: the number of leafs in the SNMP tree.

        config LWIP_14X_MEMP_NUM_SNMP_ROOTNODE
        int "SNMP rootnode Num"
        default 30   
        help
          Help: the number of branches in the SNMP tree.
                Every branch has one leaf (MEMP_NUM_SNMP_NODE) at least!

        config LWIP_14X_PBUF_POOL_SIZE
        int "Pbuf Pool Size"
        default 48
        help
          Help: the number of buffers in the pbuf pool.
    endmenu

    menu "ARP Options"

        config LWIP_14X_ARP_TABLE_SIZE
        int "ARP table Num"
        default 10
        help
          Help: Number of active MAC-IP address pairs cached.

        config LWIP_14X_ETH_PAD_SIZE
        int "ETH PAD Size"
        default 2
        help
          Help: number of bytes added before the ethernet header to ensure
                alignment of payload after that header. Since the header is 14 bytes long,
                without this padding e.g. addresses in the IP header will not be aligned
                on a 32-bit boundary, so setting this to 2 can speed up 32-bit-platforms.
    endmenu

    menu "IP Options"
        config LWIP_14X_IP_REASS_MAXAGE
        int "Reass Maxage"
        default 1
        help
          Help: Maximum time (in multiples of IP_TMR_INTERVAL - so seconds, normally)
                a fragmented IP packet waits for all fragments to arrive. If not all fragments arrived
                in this time, the whole packet is discarded.

        config LWIP_14X_IP_REASS_MAX_PBUFS
        int "Reass Max Pbufs"
        default 16  
        help
          Help: Total maximum amount of pbufs waiting to be reassembled.
                Since the received pbufs are enqueued, be sure to configure
                PBUF_POOL_SIZE > IP_REASS_MAX_PBUFS so that the stack is still able to receive
                packets even if the maximum amount of fragments is enqueued for reassembly!
    endmenu

    menu "SNMP Options"
        config LWIP_14X_SNMP_MAX_OCTET_STRING_LEN
        int "String Length Max"
        default 127
        help
          Help: The maximum length of strings used. This affects the size of
                MEMP_SNMP_VALUE elements.
    endmenu

    menu "TCP Options"
        config LWIP_14X_TCP_WND
        int "TCP Window Size"
        default 2
        help
          Help: The size of a TCP window.  This must be at least
                (2 * TCP_MSS) for things to work well

        config LWIP_14X_TCP_MAXRTX
        int "TCP data Retransmisstions Max"
        default 12
        help
          Help: Maximum number of retransmissions of data segments.

        config LWIP_14X_TCP_SYNMAXRTX
        int "TCP SYN Retransmissions Max"
        default 6 
        help
          Help: Maximum number of retransmissions of SYN segments.

        config LWIP_14X_TCP_SND_BUF
        int "TCP Sender Buffer"
        default 32
        help 
          Help: TCP sender buffer space (bytes).
                To achieve good performance, this should be at least 2 * TCP_MSS.
    endmenu

    menu "Pbuf Options"
        config LWIP_14X_PBUF_POOL_BUFSIZE
        int "Pool Each Pubf Size"
        default 1546
        help 
          Help: the size of each pbuf in the pbuf pool. The default is
                designed to accomodate single full size TCP frame in one pbuf, including
                TCP_MSS, IP header, and link header.
    endmenu

    menu "Thread Options"
        config LWIP_14X_TCPIP_THREAD_STACKSIZE
        int "TCPIP Thread Stacksize"
        default 2400
        help 
          Help: The stack size used by the main tcpip thread.

        config LWIP_14X_TCPIP_THREAD_PRIO
        int "TCPIP Thread Priority"
        default 2     
        help 
          Help: The priority assigned to the main tcpip thread.

        config LWIP_14X_TCPIP_MBOX_SIZE
        int "TCPIP MBOX Size"
        default 10     
        help 
          Help: The mailbox size for the tcpip thread messages

        config LWIP_14X_SLIPIF_THREAD_STACKSIZE
        int "SLIPIF Thread Stacksize"
        default 4096   
        help 
          Help: The stack size used by the slipif_loop thread.

        config LWIP_14X_PPP_THREAD_STACKSIZE
        int "PPP Thread Stacksize"
        default 2048  
        help 
          Help: The stack size used by the pppInputThread.

        config LWIP_14X_PPP_THREAD_PRIO
        int "PPP Thread priority"
        default 3     
        help 
          Help: The priority assigned to the pppInputThread.

        config LWIP_14X_DEFAULT_THREAD_STACKSIZE
        int "Default  Thread Stacksize"
        default 4096   
        help 
          Help: The stack size used by any other lwIP thread.  

        config LWIP_14X_DEFAULT_THREAD_PRIO
        int "Default Thread priority"
        default 4     
        help 
          Help: The priority assigned to any other lwIP thread.
    endmenu

    menu "PPP Options"
        config LWIP_14X_PPP_SUPPORT
        bool "PPP Enable"
        default 1    
        help 
          Help:Enable PPP.                                                                                                 
    endmenu
endif
```
